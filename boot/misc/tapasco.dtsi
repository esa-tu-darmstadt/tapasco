/ {
	reserved-memory {
		#address-cells = <1>;
		#size-cells = <1>;
		ranges;

		reserved: buffer@0 {
			compatible = "shared-dma-pool";
			reusable;
			reg = <0x10000000 0x10000000>;
			linux,cma-default;
		};
	};

	tapasco {
		compatible = "tapasco";
		interrupt-parent = <0x4>;
		interrupts = <0x0 0x1d 0x4 0x0 0x1e 0x4 0x0 0x1f 0x4 0x0 0x20 0x4 0x0 0x21 0x4 0x0 0x22 0x4 0x0 0x23 0x4 0x0 0x24 0x4 0x0 0x34 0x4 0x0 0x35 0x4 0x0 0x36 0x4 0x0 0x37 0x4 0x0 0x38 0x4 0x0 0x39 0x4 0x0 0x3a 0x4 0x0 0x3b 0x4>;
	};
};
