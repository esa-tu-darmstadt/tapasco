/ {
	reserved-memory {
		#address-cells = <2>;
		#size-cells = <2>;
		ranges;

		reserved: buffer@0 {
			compatible = "shared-dma-pool";
			reusable;
			reg = <0x0 0x60000000 0x0 0x20000000>;
			linux,cma-default;
		};
	};
};
